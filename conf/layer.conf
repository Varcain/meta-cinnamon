## conf/layer.conf
```bitbake
# We have a conf and classes directory, add to BBPATH
BBPATH .= ":${LAYERDIR}"

# We have recipes-* directories, add to BBFILES
BBFILES += "${LAYERDIR}/recipes-*/*/*.bb \
            ${LAYERDIR}/recipes-*/*/*.bbappend"

BBFILE_COLLECTIONS += "cinnamon"
BBFILE_PATTERN_cinnamon = "^${LAYERDIR}/"
BBFILE_PRIORITY_cinnamon = "5"
LAYERVERSION_cinnamon = "1"

PREFERRED_VERSION_libgnomekbd = "3.6.0"
PREFERRED_VERSION_zenity = "3.22.0"
```
